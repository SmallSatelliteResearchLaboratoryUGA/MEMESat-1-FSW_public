## CMakeLists.txt
```
cmake_minimum_required(VERSION 3.20.0)

set(BOARD nucleo_f103rb)

find_package(Zephyr)
project(my_zephyr_app)

target_include_directories(app PRIVATE
    "${CMAKE_CURRENT_SOURCE_DIR}"
    "${CMAKE_CURRENT_SOURCE_DIR}/include"
)

target_sources(app PRIVATE
    src/stateMachine.c
    src/obcComm.c
    src/sensors.c
    src/main.c
)
```

## Kconfig
```
source "Kconfig.zephyr" 


config UART_ASYNC_API
    bool "Enable new asynchronous UART API [EXPERIMENTAL]"
    depends on SERIAL_SUPPORT_ASYNC && SERIAL
    help
      This option enables new asynchronous UART API.
```

## prj.conf
```kconfig
CONFIG_HEAP_MEM_POOL_SIZE=256

# enable uart driver 
CONFIG_SERIAL=y
CONFIG_UART_INTERRUPT_DRIVEN=y

# config ring buffer 
CONFIG_RING_BUFFER=y

# enable uart console
CONFIG_CONSOLE=y
CONFIG_UART_CONSOLE=y
CONFIG_UART_ASYNC_API=y

#CONFIG_DMA=y

# enable gpio 
CONFIG_GPIO=y

# enable clock control 
CONFIG_CLOCK_CONTROL=y

# enable pin controller 
CONFIG_PINCTRL=y

CONFIG_RING_BUFFER=y
CONFIG_ADC=y
CONFIG_ADC_ASYNC=y

CONFIG_I2C=y 
CONFIG_SHELL=y
CONFIG_I2C_SHELL=y
CONFIG_SENSOR=y
CONFIG_STDOUT_CONSOLE=y

# 
CONFIG_NEWLIB_LIBC=y              ###
CONFIG_NEWLIB_LIBC_FLOAT_PRINTF=y ###
CONFIG_NEWLIB_LIBC_FLOAT_SCANF=y  ###

CONFIG_THREAD_CUSTOM_DATA=y
CONFIG_PRINTK=y

CONFIG_TEST_RANDOM_GENERATOR=y
CONFIG_ENTROPY_GENERATOR=y
```

## src/main.c
```c
#include <stdio.h>
#include <string.h>

#include <zephyr/device.h>
#include <zephyr/drivers/i2c.h>
#include <zephyr/drivers/gpio.h>
#include <zephyr/drivers/uart.h>
#include <zephyr/kernel.h>

#include "include/stateMachine.h"
#include "include/obcComm.h"
#include "include/sensors.h"

struct k_timer heartbeat_timer;
struct k_timer obc_quiesc_timer; 

K_THREAD_DEFINE(
    obc_comm_thread_id, // thread id
    1024,               // stack size
    obcCommService,     // entry point
    NULL,               // parameter 1
    NULL,               // parameter 2
    NULL,               // parameter 3
    7,                  // priority
    K_ESSENTIAL,        // options
    0                   // delay
);


K_THREAD_DEFINE(
    state_machine_id, 
    1024, 
    stateMachineService, 
    NULL, 
    NULL, 
    NULL, 
    7, 
    K_ESSENTIAL, 
    0
);

/*
K_THREAD_DEFINE(
    sensor_thread_id,
    1024,
    sensorService,
    NULL,
    NULL,
    NULL,
    7,
    K_FP_REGS,
    0
);
*/


K_SEM_DEFINE(
    obc_comm_sem, 
    0, 
    1
)

K_SEM_DEFINE(
    state_sem, 
    0, 
    1
)

K_SEM_DEFINE(
    sensor_sem, 
    0, 
    1
)

K_MUTEX_DEFINE(lock);

int 
main()
{
    k_thread_start(obc_comm_thread_id);
    k_thread_start(state_machine_id);
    // k_thread_start(sensor_thread_id);
    return 0;
}
```

## include/sensors.h
```c
#ifndef SENSOR_H
#define SENSOR_H

#include <zephyr/device.h>
#include <zephyr/drivers/i2c.h>
#include <zephyr/kernel.h>
#include <zephyr/sys/printk.h>
#include <zephyr/sys/util.h>
#include <zephyr/drivers/sensor.h>
#include <zephyr/random/random.h> 
#include <zephyr/types.h>
#include <string.h> 
#include <stdio.h> 

#define NUM_SOLAR_PANELS 6 
#define INA219_REG_CONFIG (0x00)
#define INA219_REG_SHUNT_VOLTAGE (0x01)
#define INA219_REG_BUS_VOLTAGE (0x02)
#define INA219_REG_POWER (0x03)
#define INA219_REG_CURRENT (0x04)
#define INA219_REG_CALIBRATION (0x05)

void sensorService(); 
void initSensorService();
void readFromDevice(const struct device *dev, uint8_t devAddr, double *regval);
void generateFakeSensorData(float *data);


#endif // SENSOR_H
```

## include/stateMachine.h
```c
#ifndef STATEMACHINE_H
#define STATEMACHINE_H

#include <zephyr/drivers/gpio.h>
#include <zephyr/kernel.h>

#define BURN_PIN 24
#define BEAT_INTERVAL K_MSEC(1000)

extern struct k_timer heartbeat_timer;

/*
enum State
{
    INIT = 0x00,
    IDLE = 0x01,
    RUN = 0x02,
    ERR = 0x03,
    LOPWR = 0x04,
    CTRL = 0x05,
};
*/

enum State 
{
    SOV = 0x00, 
    IDL = 0x01, 
    CRU = 0x02, 
    CPM = 0x03, 
    AUT = 0x04
}; 

// define state variables
extern enum State state;
extern enum State prevState;

// define semaphore
extern struct k_sem state_sem;
extern struct k_sem error_sem;

// define timers
extern struct k_timer startup;
extern struct k_timer burn;

void initStateMachine(void); 
void stateMachineService(void); 
uint8_t changeState(uint8_t target_state);
uint8_t getState(void);
void quiesc_expire_cb(struct k_timer *obc_quiesc_timer);

#endif // STATEMACHINE_H
```

## src/sensors.c
```c
#include "sensors.h" 

K_MSGQ_DEFINE(sensor_msgq, 64, 10, 8);

/**
const struct device *inaDevices[7] = {
    DEVICE_DT_GET(DT_INST(0, ti_ina219)), 
    DEVICE_DT_GET(DT_INST(1, ti_ina219)), 
    DEVICE_DT_GET(DT_INST(2, ti_ina219)), 
    DEVICE_DT_GET(DT_INST(3, ti_ina219)), 
    DEVICE_DT_GET(DT_INST(4, ti_ina219)), 
    DEVICE_DT_GET(DT_INST(5, ti_ina219)), 
    DEVICE_DT_GET(DT_INST(6, ti_ina219))
};
*/
int inaStatus[7] = {0}; 
const uint8_t inaAddresses[7] = {
    0x40, 
    0x41, 
    0x42, 
    0x43, 
    0x44, 
    0x45, 
    0x46
};
const uint8_t primaryRegs[3] = {
    INA219_REG_BUS_VOLTAGE, 
    INA219_REG_POWER, 
    INA219_REG_CURRENT
};
static struct sensor_value v_bus, power, current; 
double inaReadings[3] = {0};
double regval[3] = {0};

void sensorService()
{
    printk("DEBUG -- sensorService\n");
    initSensorService();
    while(1)
    {
        //printk("DEBUG -- sensorService loop\n");
        /* TESTING */
        readFromDevice(NULL, 0, regval);
        /* allow other threads to do work */
        k_sleep(K_MSEC(500));
    } // while
} // sensorService

void initSensorService()
{
    printk("DEBUG -- initSensorService\n");
} // initSensorService

void 
readFromDevice(
    const struct device *dev, 
    uint8_t devAddr,
    double *regval
    )
{
    //printk(" -- DEBUG -- : readFromDevice()\n");
    /**
    int ret;
    printk(" -- DEBUG -- : readFromDevice() :: devAddr: %X\n", devAddr);
    sensor_channel_get(dev, primaryRegs[0], &v_bus);
    sensor_channel_get(dev, primaryRegs[1], &power);
    sensor_channel_get(dev, primaryRegs[2], &current);
    regval[0] = sensor_value_to_double(&v_bus);
    regval[1] = sensor_value_to_double(&power);
    regval[2] = sensor_value_to_double(&current);
    char buffer[32];
    char message[80];
    */ 
    char buffer[32];
    float data[3] = {0};
    /* generate fake sensor data */
    generateFakeSensorData(data);
    /* add data to regval */
    for (int i = 0; i < 3; i++)
    {
        regval[i] = data[i];
    } // for
    // add message to queue
    k_msgq_put(&sensor_msgq, regval, K_NO_WAIT);
    // try to get message from queue
    if (k_msgq_get(&sensor_msgq, regval, K_NO_WAIT) == 0)
    {
        printk("Message: ");
        for (int i = 0; i < 3; i++)
        {
            snprintf(buffer, 32, "%f", regval[i]);
            printk("%s ", buffer);
        } // for
        printk("\n");
    } // if
    else 
    {
        printk("Failed to get message from queue\n");
    } // else
} // readFromDevice

void 
generateFakeSensorData(
    float *data
    )
{
    //printk(" -- DEBUG -- : generateFakeSensorData()\n");
    for (int i = 0; i < 3; i++)
    {
        data[i] = ((float)sys_rand32_get() / UINT32_MAX) * 10.0f;
    } // for
} // generateFakeSensorData
```
